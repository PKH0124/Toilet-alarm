## 代码/警报发送器/bsp/ht32/ht32f52352/defconfig
```kconfig
CONFIG_RT_ALIGN_SIZE=4
CONFIG_IDLE_THREAD_STACK_SIZE=512
# CONFIG_RT_USING_TIMER_SOFT is not set
# CONFIG_RT_USING_DEBUG is not set
CONFIG_RT_USING_MEMHEAP=y
CONFIG_RT_CONSOLE_DEVICE_NAME="usart1"
CONFIG_RT_MAIN_THREAD_STACK_SIZE=1024
CONFIG_FINSH_THREAD_STACK_SIZE=1024
CONFIG_FINSH_CMD_SIZE=32
# CONFIG_RT_USING_DFS is not set
# CONFIG_RT_SERIAL_USING_DMA is not set
CONFIG_SOC_HT32F52352=y
CONFIG_BSP_USING_GPIO=y
CONFIG_BSP_USING_UART=y
CONFIG_BSP_USING_USART1=y
```
